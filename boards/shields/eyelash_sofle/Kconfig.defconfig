## boards/shields/eyelash_sofle/Kconfig.defconfig
```kconfig
#
# Copyright (c) 2024 The ZMK Contributors
# SPDX-License-Identifier: MIT
#

if SHIELD_EYELASH_SOFLE_LEFT

config ZMK_KEYBOARD_NAME
    default "Eyelash Sofle"

config ZMK_SPLIT_ROLE_CENTRAL
    default y

endif # SHIELD_EYELASH_SOFLE_LEFT


if SHIELD_EYELASH_SOFLE_LEFT || SHIELD_EYELASH_SOFLE_RIGHT

config ZMK_SPLIT
    default y

if ZMK_DISPLAY

config I2C
   default y

config SSD1306
    default y

choice ZMK_DISPLAY_WORK_QUEUE
    default ZMK_DISPLAY_WORK_QUEUE_DEDICATED
endchoice

endif

if ZMK_BACKLIGHT

config PWM
    default y

config LED_PWM
    default y

endif # ZMK_BACKLIGHT

endif # SHIELD_EYELASH_SOFLE_LEFT || SHIELD_EYELASH_SOFLE_RIGHT
```
